## kernel/patch-o-matic-ng-20080316/patchlets/IPMARK/linux-2.6/net/ipv4/netfilter/Kconfig.ladd
```kconfig
config IP_NF_TARGET_IPMARK
	tristate  'IPMARK target support'
	depends on IP_NF_MANGLE
	help
	  This option adds a `IPMARK' target, which allows you to create rules
	  in the `mangle' table which alter the netfilter mark field basing
	  on the source or destination ip address of the packet.
	  This is very useful for very fast massive shaping - using only one
	  rule you can direct packets to houndreds different queues.
	  You will probably find it helpful only if your linux machine acts as
	  a shaper for many others computers.

	  If you want to compile it as a module, say M here and read
	  <file:Documentation/modules.txt>. The module will be called
	  ipt_IPMARK.o.  If unsure, say `N'.
```

## kernel/patch-o-matic-ng-20080316/patchlets/IPV4OPTSSTRIP/linux-2.6/net/ipv4/netfilter/Kconfig.ladd
```kconfig
config IP_NF_TARGET_IPV4OPTSSTRIP
	tristate  'IPV4OPTSSTRIP target support'
	depends on IP_NF_MANGLE
	help
	  This option adds an IPV4OPTSSTRIP target.
	  This target allows you to strip all IP options in a packet.
	 
	  If you want to compile it as a module, say M here and read
	  Documentation/modules.txt.  If unsure, say `N'.
```

## kernel/patch-o-matic-ng-20080316/patchlets/ROUTE/linux-2.6/net/ipv4/netfilter/Kconfig.ladd
```kconfig
config IP_NF_TARGET_ROUTE
	tristate  'ROUTE target support'
	depends on IP_NF_MANGLE
	help
	  This option adds a `ROUTE' target, which enables you to setup unusual
	  routes. For example, the ROUTE lets you route a received packet through 
	  an interface or towards a host, even if the regular destination of the 
	  packet is the router itself. The ROUTE target is also able to change the 
	  incoming interface of a packet.
	
	  The target can be or not a final target. It has to be used inside the 
	  mangle table.
	  
	  If you want to compile it as a module, say M here and read
	  Documentation/modules.txt.  The module will be called ipt_ROUTE.o.
	  If unsure, say `N'.
```

## kernel/patch-o-matic-ng-20080316/patchlets/ROUTE/linux-2.6/net/ipv6/netfilter/Kconfig.ladd
```kconfig
config IP6_NF_TARGET_ROUTE
	tristate 'ROUTE target support'
	depends on IP6_NF_MANGLE
	help
	  This option adds a `ROUTE' target, which enables you to setup unusual
	  routes. The ROUTE target is also able to change the incoming interface
	  of a packet.
	
	  The target can be or not a final target. It has to be used inside the 
	  mangle table.
	  
	  Not working as a module.
```

## kernel/patch-o-matic-ng-20080316/patchlets/TARPIT/linux-2.6/net/ipv4/netfilter/Kconfig.ladd
```kconfig
config IP_NF_TARGET_TARPIT
	tristate 'TARPIT target support'
	depends on IP_NF_FILTER
	help
	  Adds a TARPIT target to iptables, which captures and holds
	  incoming TCP connections using no local per-connection resources.
	  Connections are accepted, but immediately switched to the persist
	  state (0 byte window), in which the remote side stops sending data
	  and asks to continue every 60-240 seconds.  Attempts to close the
	  connection are ignored, forcing the remote side to time out the
	  connection in 12-24 minutes.
	
	  This offers similar functionality to LaBrea
	  <http://www.hackbusters.net/LaBrea/> but doesn't require dedicated
	  hardware or IPs.  Any TCP port that you would normally DROP or REJECT
	  can instead become a tarpit.
```

## kernel/patch-o-matic-ng-20080316/patchlets/condition/linux-2.6.16/net/netfilter/Kconfig.ladd
```kconfig
config NETFILTER_XT_MATCH_CONDITION
        tristate  '"condition" match support'
        depends on NETFILTER_XTABLES
        help
          This option allows you to match firewall rules against condition
          variables stored in the /proc/net/nf_condition directory.

          N.B.: older versions used /proc/net/ipt_condition. You can
          reenable it with "compat_dir_name".

          If you want to compile it as a module, say M here and read
          Documentation/modules.txt.  If unsure, say `N'.
```

## kernel/patch-o-matic-ng-20080316/patchlets/condition/linux/net/ipv4/netfilter/Kconfig.ladd
```kconfig
config IP_NF_MATCH_CONDITION
	tristate  'condition match support'
	depends on IP_NF_IPTABLES
	help
	  This option allows you to match firewall rules against condition
	  variables stored in the /proc/net/ipt_condition directory.
	
	  If you want to compile it as a module, say M here and read
	  Documentation/modules.txt.  If unsure, say `N'.
```

## kernel/patch-o-matic-ng-20080316/patchlets/connlimit/linux-2.6/net/ipv4/netfilter/Kconfig.ladd
```kconfig
config IP_NF_MATCH_CONNLIMIT
	tristate  'Connections/IP limit match support'
	depends on IP_NF_IPTABLES
	help
	  This match allows you to restrict the number of parallel TCP
	  connections to a server per client IP address (or address block).
	
	  If you want to compile it as a module, say M here and read
	  Documentation/modules.txt.  If unsure, say `N'.
```

## kernel/patch-o-matic-ng-20080316/patchlets/eggdrop-conntrack/linux/net/ipv4/netfilter/Kconfig.ladd
```kconfig
config IP_NF_EGG
	tristate  'Eggdrop bot support'
	depends on IP_NF_CONNTRACK
	help
	  If you are running an eggdrop hub bot on this machine, then you
	  may want to enable this feature. This enables eggdrop bots to share
	  their user file to other eggdrop bots.
	
	  If you want to compile it as a module, say M here and read
	  Documentation/modules.txt.  If unsure, say `N'.
```

## kernel/patch-o-matic-ng-20080316/patchlets/geoip/linux-2.6/net/netfilter/Kconfig.ladd
```kconfig
config NETFILTER_XT_MATCH_GEOIP
   tristate  '"geoip" match support'
   depends on NETFILTER_XTABLES
   help
          This option allows you to match a packet by its source or
          destination country.  Basically, you need a country's
          database containing all subnets and associated countries.

          For the complete procedure and understanding, read :
          http://people.netfilter.org/acidfu/geoip/howto/geoip-HOWTO.html

          If you want to compile it as a module, say M here and read
          <file:Documentation/modules.txt>.  The module will be
          called `ipt_geoip'.  If unsure, say `N'.
```

## kernel/patch-o-matic-ng-20080316/patchlets/ipp2p/linux-2.6/net/ipv4/netfilter/Kconfig.ladd
```kconfig
config IP_NF_MATCH_IPP2P
	tristate  'IPP2P match support'
	depends on IP_NF_IPTABLES
	help
	  This option makes possible to match some P2P packets
	  therefore helps controlling such traffic.
	
	  If you want to compile it as a module, say M here and read
	  <file:Documentation/modules.txt>.  If unsure, say `N'.
```

## kernel/patch-o-matic-ng-20080316/patchlets/ipv4options/linux-2.6/net/ipv4/netfilter/Kconfig.ladd
```kconfig
config IP_NF_MATCH_IPV4OPTIONS
	tristate  'IPV4OPTIONS match support'
	depends on IP_NF_IPTABLES
	help
	  This option adds a IPV4OPTIONS match.
	  It allows you to filter options like source routing,
	  record route, timestamp and router-altert.
	
	  If you say Y here, try iptables -m ipv4options --help for more information.
	 
	  If you want to compile it as a module, say M here and read
	  Documentation/modules.txt.  If unsure, say `N'.
```

## kernel/patch-o-matic-ng-20080316/patchlets/mms-conntrack-nat/linux-2.6.11/net/ipv4/netfilter/Kconfig.ladd
```kconfig
config IP_NF_NAT_MMS
	tristate
	depends on IP_NF_CONNTRACK!=n && IP_NF_NAT!=n
	default IP_NF_NAT if IP_NF_MMS=y
	default m if IP_NF_MMS=m

config IP_NF_MMS
	tristate  'MMS protocol support'
	depends on IP_NF_CONNTRACK
	help
	  Tracking MMS (Microsoft Windows Media Services) connections
	  could be problematic if random ports are used to send the
	  streaming content. This option allows users to track streaming
	  connections over random UDP or TCP ports.
	
	  If you want to compile it as a module, say M here and read
	  <file:Documentation/modules.txt>.  If unsure, say `Y'.
```

## kernel/patch-o-matic-ng-20080316/patchlets/mms-conntrack-nat/linux-2.6/net/ipv4/netfilter/Kconfig.ladd
```kconfig
config IP_NF_MMS
	tristate 'MMS protocol support'
	help
	  Tracking MMS (Microsoft Windows Media Services) connections
	  could be problematic if random ports are used to send the
	  streaming content. This option allows users to track streaming
	  connections over random UDP or TCP ports.

config IP_NF_NAT_MMS
	tristate
	depends on IP_NF_NAT!=n && IP_NF_MMS!=n
	default IP_NF_NAT if IP_NF_MMS=y
	default m if IP_NF_MMS=m
```

## kernel/patch-o-matic-ng-20080316/patchlets/pknock/linux-2.6/net/ipv4/netfilter/Kconfig.ladd
```kconfig
config IP_NF_MATCH_PKNOCK
	tristate  'Port Knocking and SPA match support'
	depends on IP_NF_IPTABLES
	help
	  This option allows you to implement Port Knocking, a stealthy
	  system for network authentication across closed ports. For
	  instance, this can be used to avoid brute force attacks to ssh
	  or ftp services. It is also implement SPA (Simple Packet
	  Authentication).

	  For more information go to:
	  http://portknocko.berlios.de/

          To compile it as a module, choose M here.  If unsure, say N.
```

## kernel/patch-o-matic-ng-20080316/patchlets/quake3-conntrack-nat/linux/net/ipv4/netfilter/Kconfig.ladd
```kconfig
config IP_NF_NAT_QUAKE3
	tristate
	depends on IP_NF_CONNTRACK!=n && IP_NF_NAT !=n
	default IP_NF_NAT if IP_NF_QUAKE3=y
	default m if IP_NF_QUAKE3=m

config IP_NF_QUAKE3
	tristate "Quake3 protocol support"
	depends on IP_NF_CONNTRACK
	help
	  Quake III Arena  connection tracking helper. This module allows for a
	  stricter firewall rulebase if one only allows traffic to a master
	  server. Connections to Quake III server IP addresses and ports returned
	  by the master server will be tracked automatically.
	
	  If you want to compile it as a module, say M here and read
	  <file:Documentation/modules.txt>.  If unsure, say `Y'.
```

## kernel/patch-o-matic-ng-20080316/patchlets/rpc/linux-2.6.12.4/net/ipv4/netfilter/Kconfig.ladd
```kconfig
config IP_NF_MATCH_RPC
	tristate  'RPC match support'
	depends on IP_NF_CONNTRACK && IP_NF_IPTABLES
	help
	  This adds CONFIG_IP_NF_MATCH_RPC, which is the RPC connection
	  matcher and tracker.
	
	  This option supplies two connection tracking modules;
	  ip_conntrack_rpc_udp and ip_conntrack_rpc_tcp, which track
	  portmapper requests using UDP and TCP respectively.
	
	  This option also adds an RPC match module for iptables, which
	  matches both via the old "record match" method and a new
	  "procedure match" method. The older method matches all RPC
	  procedure packets that relate to previously recorded packets
	  seen querying a portmapper. The newer method matches only
	  those RPC procedure packets explicitly specified by the user,
	  and that can then be related to previously recorded packets
	  seen querying a portmapper.
	
	  These three modules are required if RPCs are to be filtered
	  accurately; as RPCs are allocated pseudo-randomly to UDP and
	  TCP ports as they register with the portmapper.
	
	  Up to 8 portmapper ports per module, and up to 128 RPC
	  procedures per iptables rule, may be specified by the user,
	  to enable effective RPC management.
	
	
	  If you want to compile it as a module, say M here and read
	  <file:Documentation/modules.txt>.  If unsure, say `N'.
```

## kernel/patch-o-matic-ng-20080316/patchlets/rtsp-conntrack/linux/net/ipv4/netfilter/Kconfig.ladd
```kconfig
config IP_NF_NAT_RTSP
	tristate
	depends on IP_NF_CONNTRACK!=n && IP_NF_NAT!=n
	default IP_NF_NAT if IP_NF_RTSP=y
	default m if IP_NF_RTSP=m

config IP_NF_RTSP
	tristate  ' RTSP protocol support'
	depends on IP_NF_CONNTRACK
	help
	  Support the RTSP protocol.  This allows UDP transports to be setup
	  properly, including RTP and RDT.
	
	  If you want to compile it as a module, say 'M' here and read
	  Documentation/modules.txt.  If unsure, say 'Y'.
```

## kernel/patch-o-matic-ng-20080316/patchlets/talk-conntrack-nat/linux-2.6.11/net/ipv4/netfilter/Kconfig.ladd
```kconfig
config IP_NF_NAT_TALK
	tristate
	depends on IP_NF_CONNTRACK!=n && IP_NF_NAT!=n
	default IP_NF_NAT if IP_NF_TALK=y
	default m if IP_NF_TALK=m

config IP_NF_TALK
	tristate  'talk protocol support'
	depends on IP_NF_CONNTRACK
	help
	  The talk protocols (both otalk/talk - or talk/ntalk, to confuse
	  you by the different namings about which is old or which is new :-)
	  use an additional channel to setup the talk session and a separated
	  data channel for the actual conversation (like in FTP). Both the 
	  initiating and the setup channels are over UDP, while the data channel 
	  is over TCP, on a random port. The conntrack part of this extension
	  will enable you to let in/out talk sessions easily by matching these
	  connections as RELATED by the state match, while the NAT part helps
	  you to let talk sessions trough a NAT machine.
	
	  If you want to compile it as a module, say 'M' here and read
	  Documentation/modules.txt.  If unsure, say 'N'.
```
